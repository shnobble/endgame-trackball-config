## boards/shields/efogtech_trackball_0/Kconfig.shield
```kconfig
# No whitespace after the comma or in the keyboard name!
config SHIELD_EFOGTECH_TRACKBALL_0
    def_bool $(shields_list_contains,efogtech_trackball_0_dongle)
```
